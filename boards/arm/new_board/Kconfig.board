## boards/arm/new_board/Kconfig.board
```kconfig
# nRF52840 DK NRF52840 board configuration

# Copyright (c) 2016 Nordic Semiconductor ASA
# SPDX-License-Identifier: Apache-2.0

config BOARD_NEW_BOARD
	bool "new board"
	select HAS_DTS_GPIO
	depends on SOC_NRF52840_QIAA
```

## boards/arm/new_board/Kconfig.defconfig
```kconfig
# nRF52840 DK NRF52840 board configuration

# Copyright (c) 2016 Nordic Semiconductor ASA
# SPDX-License-Identifier: Apache-2.0

if BOARD_NEW_BOARD

config BOARD
	default "new_board"

if USB

config USB_NRFX
	default y

config USB_DEVICE_STACK
	default y

endif # USB

endif # BOARD_NEW_BOARD
```
